## sdkconfig.defaults
```kconfig
# Insert Memfault project key here
CONFIG_MEMFAULT_PROJECT_KEY="your-project-key"

# Reduce bootloader log verbosity
CONFIG_LOG_BOOTLOADER_LEVEL_WARN=y
CONFIG_LOG_BOOTLOADER_LEVEL=2

# Increase main and timer task stack sizes
CONFIG_MAIN_TASK_STACK_SIZE=7168
CONFIG_FREERTOS_TIMER_TASK_STACK_DEPTH=3072
CONFIG_ESP_SYSTEM_EVENT_TASK_STACK_SIZE=3072

# Enable watchpoint stack overflow guard
CONFIG_FREERTOS_WATCHPOINT_END_OF_STACK=y

# Enable FreeRTOS stats formatting functions, needed for 'tasks' command
CONFIG_FREERTOS_USE_TRACE_FACILITY=y
CONFIG_FREERTOS_USE_STATS_FORMATTING_FUNCTIONS=y

CONFIG_ESPTOOLPY_FLASHSIZE_4MB=y

# Workaround for issue in ESP-IDF v4.2.2 python dependencies, see:
# https://github.com/espressif/esp-idf/issues/7631#issuecomment-934212224
# We only need the typical root certs, so this works for our app.
CONFIG_MBEDTLS_CERTIFICATE_BUNDLE_DEFAULT_CMN=y

CONFIG_MEMFAULT_RAM_BACKED_COREDUMP=y

# SoftAP is unused in this example, disabling it saves about 40kB flash
CONFIG_ESP_WIFI_SOFTAP_SUPPORT=n

# Instead of pre-allocating large 16 + 4kB IN/OUT buffers when setting up the
# TLS connection, use dynamic buffers. This reduces the large memory pressure at
# the cost of some extra mallocs.
CONFIG_MBEDTLS_DYNAMIC_BUFFER=y
CONFIG_MBEDTLS_DYNAMIC_FREE_CONFIG_DATA=y
CONFIG_MBEDTLS_DYNAMIC_FREE_CA_CERT=y

# Trigger an assert if any malloc fails
CONFIG_MEMFAULT_ASSERT_ON_ALLOC_FAILURE=y
```
